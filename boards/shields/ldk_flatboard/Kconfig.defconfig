## boards/shields/ldk_flatboard/Kconfig.defconfig
```kconfig
if SHIELD_LDK_FLATBOARD_LEFT

config ZMK_KEYBOARD_NAME 
  default "ldk_flatboard"

config ZMK_SPLIT_ROLE_CENTRAL
  default y

endif

if SHIELD_LDK_FLATBOARD_LEFT || SHIELD_LDK_FLATBOARD_RIGHT

config ZMK_SPLIT
  default y

endif
```

## boards/shields/ldk_flatboard/Kconfig.shield
```kconfig
config SHIELD_LDK_FLATBOARD_LEFT
    def_bool $(shields_list_contains,ldk_flatboard_left)

config SHIELD_LDK_FLATBOARD_RIGHT
    def_bool $(shields_list_contains,ldk_flatboard_right)
    
```

## boards/shields/ldk_skeleboard/Kconfig.defconfig
```kconfig
if SHIELD_LDK_SKELEBOARD_LEFT

config ZMK_KEYBOARD_NAME 
  default "ldk_skeleboard"

config ZMK_SPLIT_ROLE_CENTRAL
  default y

endif

if SHIELD_LDK_SKELEBOARD_LEFT || SHIELD_LDK_SKELEBOARD_RIGHT

config ZMK_SPLIT
  default y

endif
```

## boards/shields/ldk_skeleboard/Kconfig.shield
```kconfig
config SHIELD_LDK_SKELEBOARD_LEFT
    def_bool $(shields_list_contains,ldk_skeleboard_left)

config SHIELD_LDK_SKELEBOARD_RIGHT
    def_bool $(shields_list_contains,ldk_skeleboard_right)
    
```

## boards/shields/ldkskel/Kconfig.defconfig
```kconfig
if SHIELD_LDKSKEL_LEFT 
config ZMK_KEYBOARD_NAME 
  default "ldkskel"

config ZMK_SPLIT_ROLE_CENTRAL
  default y

endif

if SHIELD_LDKSKEL_LEFT || SHIELD_LDKSKEL_RIGHT

config ZMK_SPLIT
  default y

endif
```

## boards/shields/ldkskel/Kconfig.shield
```kconfig
config SHIELD_LDKSKEL_LEFT
    def_bool $(shields_list_contains,ldkskel_left)

config SHIELD_LDKSKEL_RIGHT
    def_bool $(shields_list_contains,ldkskel_right)
    
```
